## Documentation/devicetree/bindings/arm/arm,psa-ffa.yaml
```yaml
# SPDX-License-Identifier: GPL-2.0
%YAML 1.2
---
$id: http://devicetree.org/schemas/arm/arm,psa-ffa.yaml#
$schema: http://devicetree.org/meta-schemas/core.yaml#

title: Arm PSA Firmware Framework for Arm v8-A

maintainers:
  - Will Deacon <will@kernel.org>

description: |
  Firmware frameworks implementing partition setup according to the PSA-FF-A
  specification defined by ARM document number ARM DEN 0077A ("Arm PSA Firmware
  Framework for Arm v8-A") [0] must provide a "manifest and image" for each
  partition to the "partition manager" so that the partition execution contexts
  can be initialised.

  In the case of a virtual FFA instance, the manifest and image details can be
  passed to the hypervisor (e.g. Linux KVM) using this binding.

  [0] https://developer.arm.com/docs/den0077/latest

properties:
  $nodename:
    const: psa_ffa

  compatible:
    oneOf:
      - const: arm,psa-ffa-1.0-hypervisor

  memory-region:
    $ref: '/schemas/types.yaml#/definitions/phandle'
    description: |
      A phandle to the reserved memory region [1] to be used by the hypervisor.
      The reserved memory region must be compatible with
      "arm,psa-ffa-1.0-hypervisor-memory-region".

      [1] Documentation/devicetree/bindings/reserved-memory/reserved-memory.txt

patternProperties:
  "^ffa_partition[0-9]+$":
    type: object
    description: One or more child nodes, each describing an FFA partition.
    properties:
      $nodename:
        const: ffa_partition

      compatible:
        oneOf:
          - const: arm,psa-ffa-1.0-partition

      uuid:
        $ref: '/schemas/types.yaml#definitions/string'
        description: |
          The 128-bit UUID [2] of the service implemented by this partition.

          [2] https://tools.ietf.org/html/rfc4122

      nr-exec-ctxs:
        $ref: '/schemas/types.yaml#/definitions/uint32'
        description: |
          The number of virtual CPUs to instantiate for this partition.

      exec-state:
        description: The execution state in which to execute the partition.
        oneOf:
          - const: "AArch64"
          - const: "AArch32"

      entry-point:
        $ref: '/schemas/types.yaml#/definitions/uint32-matrix'
        description: |
          The entry address of the partition specified as an Intermediate
          Physical Address (IPA) encoded according to the '#address-cells'
          property.

      memory-region:
        $ref: '/schemas/types.yaml#/definitions/phandle-array'
        description: |
          A list of phandles to FFA reserved memory regions [3] for this
          partition.

          [3] Documentation/devicetree/bindings/reserved-memory/arm,psa-ffa-memory.yaml

additionalProperties: false

examples:
  - |
    psa_ffa {
        compatible = "arm,psa-ffa-1.0-hypervisor";
        memory-region = <&ffa_hyp_reserved>;

        ffa_partition0 {
            compatible = "arm,psa-ffa-1.0-partition";
            uuid = "12345678-9abc-def0-1234-56789abcdef0";
            nr-exec-ctxs = <2>;
            exec-state = "AArch64";
            entry-point = <0x80000>;
            memory-region = <&ffa_reserved0 &ffa_reserved1>;
        };
    };
```

## Documentation/devicetree/bindings/arm/arm,spci.txt
```
Secure Partition Client Interface
---------------------------------

Firmware frameworks implementing partition setup according to the SPCI described
in ARM document number ARM DEN 0077A ("Secure Partition Client Interface
Specification") [0] must provide a "manifest and image" for each partition to
the "partition manager" so that the partition execution contexts can be
initialised.

In the case of a virtual SPCI instance, the manifest and image details can be
passed to the hypervisor (e.g. Linux KVM) using this binding.

Required properties:

- compatible : Should be one of:
	       "arm,spci-0.9-hypervisor"

- memory-region : A phandle to the reserved memory region [1] to be used by the
		  hypervisor. The reserved memory region must be compatible with
		  "arm,spci-0.9-hypervisor-memory-region".

- One or more child nodes, each describing an SPCI partition using the following
  required properties:

  - compatible: Should be one of:
		"arm,spci-0.9-partition"

  - uuid : The 128-bit UUID [2] of the service implemented by this partition,
	   represented as a string.

  - nr-exec-ctxs : The number of virtual CPUs to instantiate for this partition.

  - exec-state : The execution state in which to execute the partition. Should
		 be "AArch64" or "AArch32".

  - entry-point : The entry address of the partition specified as an
		  Intermediate Physical Address (IPA).

  - memory-region : A list of phandles to SPCI reserved memory regions as
		    described in [3].

[0] https://developer.arm.com/docs/den0077/latest
[1] Documentation/devicetree/bindings/reserved-memory/reserved-memory.txt
[2] https://tools.ietf.org/html/rfc4122
[3] Documentation/devicetree/bindings/reserved-memory/arm,spci-memory.txt

Example:

	#address-cells = <2>;
	#size-cells = <2>;

	spci {
		compatible = "arm,spci-0.9-hypervisor";
		memory-region = <&spci_hyp_reserved>;

		spci_partition0: spci_partition {
			compatible = "arm,spci-0.9-partition";
			uuid = "12345678-9abc-def0-1234-56789abcdef0";
			nr-exec-ctxs = <2>;
			exec-state = "AArch64";
			entry-point = <0x0 0x80000>;
			memory-region = <&spci_reserved0 &spci_reserved1>;
		};
	};
```

## Documentation/devicetree/bindings/reserved-memory/arm,psa-ffa-memory.yaml
```yaml
# SPDX-License-Identifier: GPL-2.0
%YAML 1.2
---
$id: http://devicetree.org/schemas/reserved-memory/arm,psa-ffa-memory.yaml#
$schema: http://devicetree.org/meta-schemas/core.yaml#

title: Memory Region for Arm PSA Firmware Framework for Arm v8-A

maintainers:
  - Will Deacon <will@kernel.org>

description: |
  This binding allows a PSA-FF-A implementation to describe the normal memory
  regions of a partition [1] to a hypervisor according to [2].

  The physical address range reserved for the partition can be specified as a
  static allocation using the 'reg' property or as a dynamic allocation using
  the 'size' property. If both properties are omitted, then the hypervisor can
  allocate physical memory for the partition however it sees fit.

  [1] Documentation/devicetree/bindings/arm/arm,psa-ffa.yaml
  [2] Documentation/devicetree/bindings/reserved-memory/reserved-memory.txt

properties:
  $nodename:
    pattern: "^ffa_mem(@[0-9a-f]+)?$"

  compatible:
    oneOf:
      - const: arm,psa-ffa-1.0-partition-memory-region

  ipa-range:
    $ref: '/schemas/types.yaml#/definitions/uint32-matrix'
    description: |
      The Intermediate Physical Address (IPA) range (encoded in the same way as
      a 'reg' property) at which to map the physical memory. If the IPA range is
      larger than the physical memory region then the region is mapped starting
      at the base of the IPA range.

  read-only:
    type: boolean
    description: |
      (static allocation only) The memory region has been pre-populated
      by the firmware framework and must be mapped without write permission
      at stage 2.

  non-executable:
    type: boolean
    description: |
      The memory region must be mapped without execute permission at stage 2.


required:
  - compatible

# The "reserved-memory" binding defines additional properties.
additionalProperties: true

examples:
  - |
    reserved-memory {
        #address-cells = <2>;
        #size-cells = <2>;

        ffa_reserved0: ffa_mem@100000000 {
            compatible = "arm,psa-ffa-1.0-partition-memory-region";
            reg = <0x1 0x0 0x0 0x04000000>;          // 64M @ 1GB
            ipa-range = <0x0 0x0 0x0 0x04000000>;    // 64M @ 0x0
            read-only;
        };
    };
```

## Documentation/devicetree/bindings/reserved-memory/arm,spci-memory.txt
```
Secure Partition Client Interface Memory Region
-----------------------------------------------

This binding allows a firmware framework to describe the normal memory regions
of a partition to a hypervisor.
See Documentation/devicetree/bindings/arm/arm,spci.txt for more information.

The physical address range reserved for the partition can be specified as a
static allocation using the 'reg' property or as a dynamic allocation using the
'size' property. If both properties are omitted, then the hypervisor can
allocate physical memory for the partition however it sees fit.
See Documentation/devicetree/bindings/reserved-memory/reserved-memory.txt for
more information.

Required properties:

- compatible : Should be one of:
	       "arm,spci-0.9-partition-memory-region"

Optional properties:

- ipa-range : The Intermediate Physical Address (IPA) range where the memory
	      described by the "reg" property should be mapped at stage 2. If
	      the IPA range is larger than the memory region then the region is
	      mapped starting at the base of the IPA range.

- read-only : (static allocation only) The memory region has been pre-populated
	      by the firmware framework and must be mapped without write
	      permission at stage 2.

- non-executable : The memory region must be mapped without execute permission
		   at stage 2.

Example:

	reserved-memory {
		#address-cells = <2>;
		#size-cells = <2>;
		ranges;

		spci_reserved0: spci_mem@100000000 {
			compatible = "arm,spci-0.9-partition-memory-region";
			reg = <0x1 0x0 0x0 0x04000000>;		// 64M @ 1GB

			ipa-range = <0x0 0x0 0x0 0x04000000>;	// 64M @ 0x0
			read-only;
		};
	};
```

## drivers/soc/google/Kconfig
```kconfig
# SPDX-License-Identifier: GPL-2.0-only
#
# Google SoC drivers
#

menu "Google SoC drivers"

config PKVM_S2MPU
	tristate "S2MPU driver compatible with pKVM"
	default n
	help
	This module is a driver for the stage-2 IOMMU controlled by hypervisor.

endmenu
```
